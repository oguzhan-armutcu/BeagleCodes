/*
 *********************************************************
 * @file       : AR-UART2-RS485-00A0.dts
 * @author     : Oguzhan Armutcu
 * @date       : 18 Feb 2018
 * Description : This is the src file for UART2 RS485 device tree.
 *
 *********************************************************
*/
/dts-v1/;
/plugin/;

/ {
	compatible = "ti,beaglebone", "ti,beaglebone-black";

	// identification
	part-number = "AR-UART2-RS485";
	version = "00A0";

	// resources this cape uses
	exclusive-use =
		"P9.21",		// uart2_txd
		"P9.22",		// uart2_rxd
		"P8.38",		// uart2_rtsn  conflict with uart5
		"uart2";		// hardware ip used

	fragment@0 {
		target = <&am33xx_pinmux>;
		__overlay__ {
			ar_uart2_pins: pinmux_ar_uart2_pins {
				pinctrl-single,pins = <
					0x150 0x21		/* spi0_sclk.uart2_rxd | MODE1 */
					0x154 0x01 		/* spi0_d0.uart2_txd | MODE1 */
					0x0C4 0x06	   /* lcd_data9.uart2_rtsn pulldown | mode 6 */
				>;
			};
		};
	};

	fragment@1 {
		target = <&uart2>;
		__overlay__ {
			status = "okay";
			pinctrl-names = "default";
			pinctrl-0 = <&ar_uart2_pins>;

		};
	};
};
